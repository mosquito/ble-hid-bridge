## sdkconfig.defaults
```kconfig
# ESP-IDF defaults for ESP32-S3
CONFIG_IDF_TARGET="esp32s3"

# Flash size 4MB
CONFIG_ESPTOOLPY_FLASHSIZE_4MB=y
# Auto-detect and patch flash size in binary header during upload
CONFIG_ESPTOOLPY_HEADER_FLASHSIZE_UPDATE=y

# Custom partition table (4MB layout)
CONFIG_PARTITION_TABLE_CUSTOM=y
CONFIG_PARTITION_TABLE_CUSTOM_FILENAME="partitions.csv"

# Console on Hardware UART (D6=TX GPIO43, D7=RX GPIO44)
# Connect USB-UART adapter to D6/D7 at 115200 baud for logs
CONFIG_ESP_CONSOLE_UART_CUSTOM=y
CONFIG_ESP_CONSOLE_UART_TX_GPIO=43
CONFIG_ESP_CONSOLE_UART_RX_GPIO=44
CONFIG_ESP_CONSOLE_UART_BAUDRATE=115200

# Bluetooth (Bluedroid stack with BLE GATT client)
CONFIG_BT_ENABLED=y
CONFIG_BT_BLUEDROID_ENABLED=y
CONFIG_BT_BLUEDROID_PINNED_TO_CORE_1=y
CONFIG_BT_BLUEDROID_PINNED_TO_CORE=1
CONFIG_BT_BLE_ENABLED=y
CONFIG_BT_GATTC_ENABLE=y
CONFIG_BT_GATTC_NOTIF_REG_MAX=64
CONFIG_BT_BTU_TASK_STACK_SIZE=16384
CONFIG_BT_BLE_42_FEATURES_SUPPORTED=y

# WiFi + BLE coexistence
CONFIG_ESP_COEX_SW_COEXIST_ENABLE=y

# USB TinyUSB HID Device (one combined mouse+keyboard interface)
CONFIG_TINYUSB_HID_COUNT=1

# Enable C++ exceptions
CONFIG_COMPILER_CXX_EXCEPTIONS=y

# FreeRTOS
CONFIG_FREERTOS_HZ=1000

# Task watchdog - monitor both cores (run loop has vTaskDelay)
CONFIG_ESP_TASK_WDT_CHECK_IDLE_TASK_CPU1=y
```
